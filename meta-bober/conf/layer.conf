## meta-bober/conf/layer.conf
```bitbake
# We have a conf and classes directory, add to BBPATH
BBPATH .= ":${LAYERDIR}"

# We have recipes-* directories, add to BBFILES
BBFILES += "${LAYERDIR}/recipes-*/*/*.bb \
            ${LAYERDIR}/recipes-*/*/*.bbappend"

BBFILE_COLLECTIONS += "meta-bober"
BBFILE_PATTERN_meta-bober = "^${LAYERDIR}/"
BBFILE_PRIORITY_meta-bober = "99"

LAYERDEPENDS_meta-bober = "core"
LAYERSERIES_COMPAT_meta-bober = "kirkstone"
```

## meta-bober/conf/machine/beaglebone-lab.conf
```bitbake
#@TYPE: Machine
#@NAME: Beaglebone machine
#@DESCRIPTION: Machine configuration for http://beagleboard.org/black board

MACHINEOVERRIDES =. "beaglebone-yocto:"
include conf/machine/beaglebone-yocto.conf

EXTRA_IMAGEDEPENDS += " u-boot-lab-script"
DTB_FILES = "am335x-boneblack.dtb"

WKS_FILE = "beaglebone-lab.wks"
PREFERRED_PROVIDER_virtual/bootloader ?= "u-boot-lab"
IMAGE_BOOT_FILES = "u-boot.${UBOOT_SUFFIX} ${SPL_BINARY} ${KERNEL_IMAGETYPE} boot.scr" 
IMAGE_FSTYPES = "wic.lzma tar.zst wic.bmap"
```

## meta-bober/wic/beaglebone-lab.wks
```
# short-description: Create SD card image for Beaglebone
# long-description: Creates a partitioned SD card image for Beaglebone.
# Boot files are located in the first vfat partition.

part /boot --source bootimg-partition --ondisk mmcblk0 --fstype=vfat --label boot --align 4 --fixed-size 32 --sourceparams="loader=u-boot" --use-uuid
part / --source rootfs --ondisk mmcblk0 --fstype=ext4 --label root1 --align 4 --use-uuid --size=512 --active
part / --source rootfs --ondisk mmcblk0 --fstype=ext4 --label root2 --align 4 --use-uuid --size=512
bootloader --append="console=ttyS0,115200"
```
